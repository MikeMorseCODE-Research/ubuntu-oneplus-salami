// SPDX-License-Identifier: BSD-2-Clause
/*
 * Copyright (c) 2025, Boston Edison Media and Production Consultants
 * OnePlus 11 5G (salami) - SM8550 8GB variant
 * Derived from sm8550-oneplus-aston.dts by Shandorman
 */

/dts-v1/;
#include "sm8550-oneplus-aston.dts"

&oplus_mem {
	reg = <0x00 0x80000000 0x00 0xe00000
	       0x00 0x811d0000 0x00 0x56e30000
	       0x00 0xd8140000 0x00 0x20000
	       0x00 0xd8800000 0x00 0x00
	       0x00 0xe1bb0000 0x00 0x1e450000
	       0x08 0x80000000 0x00 0x35700000
	       0x08 0xc0000000 0x00 0x80000000
	       0x09 0x40000000 0x00 0xd4900000>;
};

/ {
	model = "OnePlus 11 5G";
	compatible = "oneplus,salami", "qcom,sm8550";
};
